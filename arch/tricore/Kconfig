## arch/tricore/Kconfig
```kconfig
# Copyright (c) 2024 Infineon Technologies AG
# SPDX-License-Identifier: Apache-2.0

menu "Tricore Options"
	depends on TRICORE

config ARCH
	string
	default "tricore"

config CPU_TC162
	select ARCH_HAS_NOCACHE_MEMORY_SUPPORT
	bool

config TRICORE_CSA_COUNT
	int "Number of Context Save Areas allocated"
	default 256

menu "Tricore Processor Options"

config DCACHE_LINE_SIZE
	default 32

config ICACHE_LINE_SIZE
	default 32

config GEN_ISR_TABLES
	default y

config GEN_IRQ_VECTOR_TABLE
	default n

config NUM_IRQS
	int
	default 1024

config NUM_IRQ_PRIORITIES
	int
	default 256

endmenu
endmenu
```

## boards/infineon/kit_a2g_tc337/Kconfig.kit_a2g_tc337
```kconfig
# Copyright 2024 Infineon Technologies AG
# SPDX-License-Identifier: Apache-2.0

config BOARD_KIT_A2G_TC337
	bool "Infineon A2G TC337 Starter Kit"
	select SOC_TC337LP
```

## boards/infineon/kit_a2g_tc375_lite/Kconfig.kit_a2g_tc375_lite
```kconfig
# Copyright 2024 Infineon Technologies AG
# SPDX-License-Identifier: Apache-2.0

config BOARD_KIT_A2G_TC375_LITE
	bool "Infineon TC375 LiteKit"
	select SOC_TC375TP
```

## boards/infineon/kit_a2g_tc375_lite/board.yml
```yaml
board:
  name: kit_a2g_tc375_lite
  vendor: infineon
  socs:
    - name: tc375tp
```

## boards/infineon/kit_a2g_tc377tx_3v3_e_tr/Kconfig.kit_a2g_tc377tx_3v3_e_tr
```kconfig
# Copyright 2024 Infineon Technologies AG
# SPDX-License-Identifier: Apache-2.0

config BOARD_KIT_A2G_TC377TX_3V3_E_TR
	bool "Infineon TC377TX TriBoard with Expansion Header"
	select SOC_TC377TX
```

## boards/infineon/kit_a2g_tc377tx_3v3_e_tr/board.yml
```yaml
board:
  name: kit_a2g_tc377tx_3v3_e_tr
  vendor: infineon
  socs:
    - name: tc377tx
```

## drivers/can/Kconfig.mcmcan
```kconfig
# MCMCAN configuration options

# Copyright (c) 2024 Infineon Technologies AG
# SPDX-License-Identifier: Apache-2.0

config CAN_MCMCAN
	bool "MCMCAN driver"
	default y
	depends on DT_HAS_INFINEON_MCMCAN_ENABLED
	depends on CLOCK_CONTROL
	select CAN_MCAN
	select PINCTRL
	help
	  Enable support for mcmcan driver.
```

## drivers/clock_control/Kconfig.tc3xx_ccu
```kconfig
# Copyright (c) Infineon Technologies AG
# SPDX-License-Identifier: Apache-2.0

config CLOCK_CONTROL_TC3XX_CCU
	bool "TC3xx Clock Control Unit Driver"
	default y
	depends on DT_HAS_INFINEON_TC3XX_CCU_ENABLED
```

## drivers/gpio/Kconfig.tc3xx
```kconfig
# Copyright (c) 2024 Infineon Technologies AG
# SPDX-License-Identifier: Apache-2.0

config GPIO_TC3XX
	bool "GPIO Driver for TC3xx family of MCUs"
	default y
	depends on DT_HAS_INFINEON_TC3XX_GPIO_ENABLED
	help
	  Enable GPIO driver for TC3xx family of MCUs
```

## drivers/interrupt_controller/Kconfig.tc_ir
```kconfig
# Copyright (c) 2024 Infineon Technologies AG
# SPDX-License-Identifier: Apache-2.0
 
if SOC_SERIES_TC3XX

config TC_IR
	bool

endif # SOC_SERIES_TC3XX
```

## drivers/mdio/Kconfig.dwc_eth_qos
```kconfig
# Copyright (c) 2024 Infineon Technologies AG
# SPDX-License-Identifier: Apache-2.0

config MDIO_DWC_ETH_QOS
	bool "Synopsys DWC Ethernet QoS MDIO driver"
	default y
	depends on DT_HAS_SNPS_DWC_ETH_QOS_MDIO_ENABLED
	help
	  Enable Synopsys DesignWare Cores Ethernet Quality-of-Service MDIO driver.
```

## drivers/pinctrl/Kconfig.tc3xx
```kconfig
# Copyright (c) 2024 Infineon Technologies AG
# SPDX-License-Identifier: Apache-2.0

config PINCTRL_TC3XX
	bool "Infineon TC3XX pin controller driver"
	default y
	depends on DT_HAS_INFINEON_TC3XX_PINCTRL_ENABLED
	help
	  Infineon TC3XX pinctrl driver
```

## drivers/ptp_clock/Kconfig.dwmac
```kconfig
# Copyright 2024 Infineon Technologies AG
# SPDX-License-Identifier: Apache-2.0

config PTP_CLOCK_DWMAC
	bool "DWMAC PTP clock driver support"
	default y if DT_HAS_SNPS_DWC_ETH_QOS_PTP_CLOCK_ENABLED 
	depends on PTP_CLOCK || NET_L2_PTP
	help
	  Enable DWMAC PTP Clock support.
```

## drivers/serial/Kconfig.asclin
```kconfig
# Copyright (c) 2024 Infineon Technologies AG
# SPDX-License-Identifier: Apache-2.0

config UART_ASCLIN
	bool "Infineon ASCLIN UART driver"
	default y
	depends on DT_HAS_INFINEON_ASCLIN_UART_ENABLED
	select SERIAL_HAS_DRIVER
#	select SERIAL_SUPPORT_INTERRUPT
	help
	  Enable the Infineon ASCLIN UART driver
```

## drivers/timer/Kconfig.tc3xx_stm
```kconfig
DT_CHOSEN_SYSTEM_TIMER := infineon,system-timer

config TC3XX_STM_TIMER
    bool "TC3xx Sytem Timer Module"
	depends on SOC_SERIES_TC3XX
	select TICKLESS_CAPABLE
	select SYSTEM_TIMER_HAS_DISABLE_SUPPORT
	select TIMER_HAS_64BIT_CYCLE_COUNTER
	default $(dt_chosen_enabled,$(DT_CHOSEN_SYSTEM_TIMER))
```

## dts/bindings/can/infineon,mcmcan-node.yaml
```yaml
description: Infineon MCMCAN node driver 

compatible: "infineon,mcmcan-node"

include: ["bosch,m_can-base.yaml", "pinctrl-device.yaml"]

properties:
  reg:
    required: true
  reg-names:
    required: true
  interrupts:
    required: true
  interrupt-names:
    required: true
```

## dts/bindings/can/infineon,mcmcan.yaml
```yaml
description: Infineon MCMCAN module driver 

compatible: "infineon,mcmcan"

include: ["base.yaml"]

properties:
  reg:
    required: true
  clocks:
    required: true
```

## dts/bindings/clock/infineon,tc3xx-ccu-clock.yaml
```yaml
# Copyright (c) Infineon Technologies AG
# SPDX-License-Identifier: Apache-2.0

description: TC3XX CCU Clock

compatible: "infineon,tc3xx-ccu-clock"

include: fixed-factor-clock.yaml

properties:
  field:
    type: array

  select-field:
    type: array

  cpu-field:
    type: array
```

## dts/bindings/clock/infineon,tc3xx-ccu.yaml
```yaml
# Copyright (c) Infineon Technologies AG
# SPDX-License-Identifier: Apache-2.0

description: TC3XX Clock Control Unit

compatible: "infineon,tc3xx-ccu"

include: [base.yaml, clock-controller.yaml]

properties:
  reg:
    required: true

  "#clock-cells":
    const: 1

clock-cells:
  - id
```

## dts/bindings/clock/infineon,tc3xx-pll-clock.yaml
```yaml
# Copyright (c) Infineon Technologies AG
# SPDX-License-Identifier: Apache-2.0

description: TC3XX PLL Clock

compatible: "infineon,tc3xx-pll-clock"

include: clock-controller.yaml

properties:
  n-div:
      type: int
      required: true
  
  p-div:
      type: int
      required: true

  divby:
    type: boolean

  clocks:
    type: phandle-array
    description: input clock source

  "#clock-cells":
    const: 0
```

## dts/bindings/cpu/infineon,tc162.yaml
```yaml
# Copyright 2024 Infineon Technologies AG
# SPDX-License-Identifier: Apache-2.0

description: Infineon Tricore 1.6.2

compatible: "infineon,tc162"

include: cpu.yaml
```

## dts/bindings/ethernet/infineon,tc3xx-geth.yaml
```yaml
# Copyright (c) 2020, Linaro Limited
# SPDX-License-Identifier: Apache-2.0

description: Infineon TC3XX GETH module

compatible: "infineon,tc3xx-geth"

include: [base.yaml, pinctrl-device.yaml]

properties:
  clocks:
    required: true
```

## dts/bindings/ethernet/snps,designware-ethernet-rx-queues.yaml
```yaml
# Copyright (c) 2024, Infineon Technologies AG
# SPDX-License-Identifier: Apache-2.0

description: Synopsys DesignWare Ethernet RX Queues Config

compatible: "snps,designware-ethernet-rx-queues"

properties:
  snps,rx-queues-to-use:
    type: int
    description: number of RX queues to be used in the driver
  snps,rx-sched-sp:
    type: boolean
    description: Strict priority
  snps,rx-sched-wsp:
    type: boolean
    description: Weighted Strict priority

child-binding:
  description: RX Queue configuration

  properties:
    snps,size:
      type: int
      description: Dedicated Fifo size
    snps,threshold:
      type: int
      enum:
        - 32
        - 64
        - 96
        - 128
        - 192
        - 256
        - 384
        - 512
    snps,cut-through:
      type: boolean
    snps,store-and-forward:
      type: boolean
    snps,dcb-algorithm:
      type: boolean
      description: Queue to be enabled as DCB
    snps,avb-algorithm:
      type: boolean
      description: Queue to be enabled as AVB
    snps,map-to-dma-channel:
      type: int
      description: DMA channel id to map
    snps,route-avcp:
      type: boolean
      description: AV Untagged Control packets
    snps,route-ptp:
      type: boolean
      description: PTP Packets
    snps,route-dcbcp:
      type: boolean
      description: DCB Control Packets
    snps,route-up:
      type: boolean
      description: Untagged Packets
    snps,route-multi-broad:
      type: boolean
      description: Multicast & Broadcast Packets
    snps,priority:
      type: int
      description: Bitmask of the tagged frames priorities assigned to the queue
    snps,size:
      type: int
      description: Size of queue memeory
```

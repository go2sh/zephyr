
/*
* Copyright (c) 2024 Infineon Technologies AG
* SPDX-License-Identifier: Apache-2.0
*/

#include <zephyr/dt-bindings/pinctrl/tc3xx-pinctrl.h>
            
&p00 {
	ngpios = <13>;
};
&p01 {
	ngpios = <8>;
};
&p02 {
	ngpios = <12>;
};
&p10 {
	ngpios = <9>;
};
&p11 {
	ngpios = <16>;
};
&p12 {
	ngpios = <2>;
};
&p13 {
	ngpios = <4>;
};
&p14 {
	ngpios = <11>;
};
&p15 {
	ngpios = <9>;
};
&p20 {
	ngpios = <15>;
	gpio-reserved-ranges = <4 2>;
};
&p21 {
	ngpios = <8>;
};
&p22 {
	ngpios = <13>;
};
&p23 {
	ngpios = <8>;
};
&p32 {
	ngpios = <8>;
};
&p33 {
	ngpios = <16>;
};
&p34 {
	ngpios = <6>;
};

&pinctrl {
	/omit-if-no-ref/ asclin0_cts_p14_9: asclin0_cts_p14_9 {
		pinmux = <TC3XX_INPUT_PINMUX(14, 9, A)>;
		pin-type = <1>;
		pad-type = "fast";
	};
	/omit-if-no-ref/ asclin0_rts_p14_7: asclin0_rts_p14_7 {
		pinmux = <TC3XX_OUTPUT_PINMUX(14, 7, O2)>;
		output-enable;
		pad-type = "slow";
	};
	/omit-if-no-ref/ asclin0_rx_p14_1: asclin0_rx_p14_1 {
		pinmux = <TC3XX_INPUT_PINMUX(14, 1, A)>;
		pin-type = <0>;
		pad-type = "fast";
	};
	/omit-if-no-ref/ asclin0_rx_p15_3: asclin0_rx_p15_3 {
		pinmux = <TC3XX_INPUT_PINMUX(15, 3, B)>;
		pin-type = <0>;
		pad-type = "fast";
	};
	/omit-if-no-ref/ asclin0_rx_p33_10: asclin0_rx_p33_10 {
		pinmux = <TC3XX_INPUT_PINMUX(33, 10, D)>;
		pin-type = <0>;
		pad-type = "fast";
	};
	/omit-if-no-ref/ asclin0_sclk_p14_0: asclin0_sclk_p14_0 {
		pinmux = <TC3XX_OUTPUT_PINMUX(14, 0, O6)>;
		output-enable;
		pad-type = "fast";
	};
	/omit-if-no-ref/ asclin0_sclk_p15_2: asclin0_sclk_p15_2 {
		pinmux = <TC3XX_OUTPUT_PINMUX(15, 2, O6)>;
		output-enable;
		pad-type = "fast";
	};
	/omit-if-no-ref/ asclin0_tx_p14_0: asclin0_tx_p14_0 {
		pinmux = <TC3XX_OUTPUT_PINMUX(14, 0, O2)>;
		output-enable;
		pad-type = "fast";
	};
	/omit-if-no-ref/ asclin0_tx_p14_1: asclin0_tx_p14_1 {
		pinmux = <TC3XX_OUTPUT_PINMUX(14, 1, O2)>;
		output-enable;
		pad-type = "fast";
	};
	/omit-if-no-ref/ asclin0_tx_p15_2: asclin0_tx_p15_2 {
		pinmux = <TC3XX_OUTPUT_PINMUX(15, 2, O2)>;
		output-enable;
		pad-type = "fast";
	};
	/omit-if-no-ref/ asclin0_tx_p15_3: asclin0_tx_p15_3 {
		pinmux = <TC3XX_OUTPUT_PINMUX(15, 3, O2)>;
		output-enable;
		pad-type = "fast";
	};
	/omit-if-no-ref/ asclin0_tx_p33_9: asclin0_tx_p33_9 {
		pinmux = <TC3XX_OUTPUT_PINMUX(33, 9, O6)>;
		output-enable;
		pad-type = "slow";
	};
	/omit-if-no-ref/ asclin1_cts_p20_7: asclin1_cts_p20_7 {
		pinmux = <TC3XX_INPUT_PINMUX(20, 7, A)>;
		pin-type = <1>;
		pad-type = "fast";
	};
	/omit-if-no-ref/ asclin1_cts_p32_4: asclin1_cts_p32_4 {
		pinmux = <TC3XX_INPUT_PINMUX(32, 4, B)>;
		pin-type = <1>;
		pad-type = "fast";
	};
	/omit-if-no-ref/ asclin1_rts_p20_6: asclin1_rts_p20_6 {
		pinmux = <TC3XX_OUTPUT_PINMUX(20, 6, O2)>;
		output-enable;
		pad-type = "slow";
	};
	/omit-if-no-ref/ asclin1_rts_p23_1: asclin1_rts_p23_1 {
		pinmux = <TC3XX_OUTPUT_PINMUX(23, 1, O2)>;
		output-enable;
		pad-type = "fast";
	};
	/omit-if-no-ref/ asclin1_rx_p2_3: asclin1_rx_p2_3 {
		pinmux = <TC3XX_INPUT_PINMUX(2, 3, G)>;
		pin-type = <0>;
		pad-type = "slow";
	};
	/omit-if-no-ref/ asclin1_rx_p11_10: asclin1_rx_p11_10 {
		pinmux = <TC3XX_INPUT_PINMUX(11, 10, E)>;
		pin-type = <0>;
		pad-type = "fast";
	};
	/omit-if-no-ref/ asclin1_rx_p14_8: asclin1_rx_p14_8 {
		pinmux = <TC3XX_INPUT_PINMUX(14, 8, D)>;
		pin-type = <0>;
		pad-type = "slow";
	};
	/omit-if-no-ref/ asclin1_rx_p15_1: asclin1_rx_p15_1 {
		pinmux = <TC3XX_INPUT_PINMUX(15, 1, A)>;
		pin-type = <0>;
		pad-type = "fast";
	};
	/omit-if-no-ref/ asclin1_rx_p15_5: asclin1_rx_p15_5 {
		pinmux = <TC3XX_INPUT_PINMUX(15, 5, B)>;
		pin-type = <0>;
		pad-type = "fast";
	};
	/omit-if-no-ref/ asclin1_rx_p20_9: asclin1_rx_p20_9 {
		pinmux = <TC3XX_INPUT_PINMUX(20, 9, C)>;
		pin-type = <0>;
		pad-type = "fast";
	};
	/omit-if-no-ref/ asclin1_rx_p33_13: asclin1_rx_p33_13 {
		pinmux = <TC3XX_INPUT_PINMUX(33, 13, F)>;
		pin-type = <0>;
		pad-type = "fast";
	};
	/omit-if-no-ref/ asclin1_sclk_p15_0: asclin1_sclk_p15_0 {
		pinmux = <TC3XX_OUTPUT_PINMUX(15, 0, O6)>;
		output-enable;
		pad-type = "fast";
	};
	/omit-if-no-ref/ asclin1_sclk_p20_10: asclin1_sclk_p20_10 {
		pinmux = <TC3XX_OUTPUT_PINMUX(20, 10, O6)>;
		output-enable;
		pad-type = "fast";
	};
	/omit-if-no-ref/ asclin1_sclk_p33_11: asclin1_sclk_p33_11 {
		pinmux = <TC3XX_OUTPUT_PINMUX(33, 11, O2)>;
		output-enable;
		pad-type = "fast";
	};
	/omit-if-no-ref/ asclin1_sclk_p33_12: asclin1_sclk_p33_12 {
		pinmux = <TC3XX_OUTPUT_PINMUX(33, 12, O4)>;
		output-enable;
		pad-type = "fast";
	};
	/omit-if-no-ref/ asclin1_slso_p14_3: asclin1_slso_p14_3 {
		pinmux = <TC3XX_OUTPUT_PINMUX(14, 3, O4)>;
		output-enable;
		pad-type = "slow";
	};
	/omit-if-no-ref/ asclin1_slso_p20_8: asclin1_slso_p20_8 {
		pinmux = <TC3XX_OUTPUT_PINMUX(20, 8, O2)>;
		output-enable;
		pad-type = "fast";
	};
	/omit-if-no-ref/ asclin1_slso_p33_10: asclin1_slso_p33_10 {
		pinmux = <TC3XX_OUTPUT_PINMUX(33, 10, O4)>;
		output-enable;
		pad-type = "fast";
	};
	/omit-if-no-ref/ asclin1_tx_p2_2: asclin1_tx_p2_2 {
		pinmux = <TC3XX_OUTPUT_PINMUX(2, 2, O2)>;
		output-enable;
		pad-type = "fast";
	};
	/omit-if-no-ref/ asclin1_tx_p11_12: asclin1_tx_p11_12 {
		pinmux = <TC3XX_OUTPUT_PINMUX(11, 12, O2)>;
		output-enable;
		pad-type = "fast";
	};
	/omit-if-no-ref/ asclin1_tx_p14_10: asclin1_tx_p14_10 {
		pinmux = <TC3XX_OUTPUT_PINMUX(14, 10, O4)>;
		output-enable;
		pad-type = "fast";
	};
	/omit-if-no-ref/ asclin1_tx_p15_0: asclin1_tx_p15_0 {
		pinmux = <TC3XX_OUTPUT_PINMUX(15, 0, O2)>;
		output-enable;
		pad-type = "fast";
	};
	/omit-if-no-ref/ asclin1_tx_p15_1: asclin1_tx_p15_1 {
		pinmux = <TC3XX_OUTPUT_PINMUX(15, 1, O2)>;
		output-enable;
		pad-type = "fast";
	};
	/omit-if-no-ref/ asclin1_tx_p15_4: asclin1_tx_p15_4 {
		pinmux = <TC3XX_OUTPUT_PINMUX(15, 4, O2)>;
		output-enable;
		pad-type = "fast";
	};
	/omit-if-no-ref/ asclin1_tx_p15_5: asclin1_tx_p15_5 {
		pinmux = <TC3XX_OUTPUT_PINMUX(15, 5, O2)>;
		output-enable;
		pad-type = "fast";
	};
	/omit-if-no-ref/ asclin1_tx_p20_10: asclin1_tx_p20_10 {
		pinmux = <TC3XX_OUTPUT_PINMUX(20, 10, O2)>;
		output-enable;
		pad-type = "fast";
	};
	/omit-if-no-ref/ asclin1_tx_p33_12: asclin1_tx_p33_12 {
		pinmux = <TC3XX_OUTPUT_PINMUX(33, 12, O2)>;
		output-enable;
		pad-type = "fast";
	};
	/omit-if-no-ref/ asclin1_tx_p33_13: asclin1_tx_p33_13 {
		pinmux = <TC3XX_OUTPUT_PINMUX(33, 13, O2)>;
		output-enable;
		pad-type = "fast";
	};
	/omit-if-no-ref/ asclin2_cts_p10_7: asclin2_cts_p10_7 {
		pinmux = <TC3XX_INPUT_PINMUX(10, 7, A)>;
		pin-type = <1>;
		pad-type = "slow";
	};
	/omit-if-no-ref/ asclin2_cts_p33_5: asclin2_cts_p33_5 {
		pinmux = <TC3XX_INPUT_PINMUX(33, 5, B)>;
		pin-type = <1>;
		pad-type = "slow";
	};
	/omit-if-no-ref/ asclin2_rts_p10_8: asclin2_rts_p10_8 {
		pinmux = <TC3XX_OUTPUT_PINMUX(10, 8, O2)>;
		output-enable;
		pad-type = "slow";
	};
	/omit-if-no-ref/ asclin2_rts_p33_4: asclin2_rts_p33_4 {
		pinmux = <TC3XX_OUTPUT_PINMUX(33, 4, O2)>;
		output-enable;
		pad-type = "slow";
	};
	/omit-if-no-ref/ asclin2_rx_p2_0: asclin2_rx_p2_0 {
		pinmux = <TC3XX_INPUT_PINMUX(2, 0, G)>;
		pin-type = <0>;
		pad-type = "fast";
	};
	/omit-if-no-ref/ asclin2_rx_p2_1: asclin2_rx_p2_1 {
		pinmux = <TC3XX_INPUT_PINMUX(2, 1, B)>;
		pin-type = <0>;
		pad-type = "slow";
	};
	/omit-if-no-ref/ asclin2_rx_p2_10: asclin2_rx_p2_10 {
		pinmux = <TC3XX_INPUT_PINMUX(2, 10, C)>;
		pin-type = <0>;
		pad-type = "slow";
	};
	/omit-if-no-ref/ asclin2_rx_p10_6: asclin2_rx_p10_6 {
		pinmux = <TC3XX_INPUT_PINMUX(10, 6, D)>;
		pin-type = <0>;
		pad-type = "slow";
	};
	/omit-if-no-ref/ asclin2_rx_p14_3: asclin2_rx_p14_3 {
		pinmux = <TC3XX_INPUT_PINMUX(14, 3, A)>;
		pin-type = <0>;
		pad-type = "slow";
	};
	/omit-if-no-ref/ asclin2_rx_p32_6: asclin2_rx_p32_6 {
		pinmux = <TC3XX_INPUT_PINMUX(32, 6, F)>;
		pin-type = <0>;
		pad-type = "slow";
	};
	/omit-if-no-ref/ asclin2_rx_p33_8: asclin2_rx_p33_8 {
		pinmux = <TC3XX_INPUT_PINMUX(33, 8, E)>;
		pin-type = <0>;
		pad-type = "fast";
	};
	/omit-if-no-ref/ asclin2_sclk_p2_4: asclin2_sclk_p2_4 {
		pinmux = <TC3XX_OUTPUT_PINMUX(2, 4, O2)>;
		output-enable;
		pad-type = "fast";
	};
	/omit-if-no-ref/ asclin2_sclk_p10_6: asclin2_sclk_p10_6 {
		pinmux = <TC3XX_OUTPUT_PINMUX(10, 6, O2)>;
		output-enable;
		pad-type = "slow";
	};
	/omit-if-no-ref/ asclin2_sclk_p14_2: asclin2_sclk_p14_2 {
		pinmux = <TC3XX_OUTPUT_PINMUX(14, 2, O6)>;
		output-enable;
		pad-type = "slow";
	};
	/omit-if-no-ref/ asclin2_sclk_p33_7: asclin2_sclk_p33_7 {
		pinmux = <TC3XX_OUTPUT_PINMUX(33, 7, O2)>;
		output-enable;
		pad-type = "slow";
	};
	/omit-if-no-ref/ asclin2_sclk_p33_9: asclin2_sclk_p33_9 {
		pinmux = <TC3XX_OUTPUT_PINMUX(33, 9, O4)>;
		output-enable;
		pad-type = "slow";
	};
	/omit-if-no-ref/ asclin2_slso_p2_3: asclin2_slso_p2_3 {
		pinmux = <TC3XX_OUTPUT_PINMUX(2, 3, O2)>;
		output-enable;
		pad-type = "slow";
	};
	/omit-if-no-ref/ asclin2_slso_p10_5: asclin2_slso_p10_5 {
		pinmux = <TC3XX_OUTPUT_PINMUX(10, 5, O6)>;
		output-enable;
		pad-type = "slow";
	};
	/omit-if-no-ref/ asclin2_slso_p33_6: asclin2_slso_p33_6 {
		pinmux = <TC3XX_OUTPUT_PINMUX(33, 6, O2)>;
		output-enable;
		pad-type = "slow";
	};
	/omit-if-no-ref/ asclin2_tx_p2_0: asclin2_tx_p2_0 {
		pinmux = <TC3XX_OUTPUT_PINMUX(2, 0, O2)>;
		output-enable;
		pad-type = "fast";
	};
	/omit-if-no-ref/ asclin2_tx_p2_9: asclin2_tx_p2_9 {
		pinmux = <TC3XX_OUTPUT_PINMUX(2, 9, O2)>;
		output-enable;
		pad-type = "slow";
	};
	/omit-if-no-ref/ asclin2_tx_p10_5: asclin2_tx_p10_5 {
		pinmux = <TC3XX_OUTPUT_PINMUX(10, 5, O2)>;
		output-enable;
		pad-type = "slow";
	};
	/omit-if-no-ref/ asclin2_tx_p14_2: asclin2_tx_p14_2 {
		pinmux = <TC3XX_OUTPUT_PINMUX(14, 2, O2)>;
		output-enable;
		pad-type = "slow";
	};
	/omit-if-no-ref/ asclin2_tx_p14_3: asclin2_tx_p14_3 {
		pinmux = <TC3XX_OUTPUT_PINMUX(14, 3, O2)>;
		output-enable;
		pad-type = "slow";
	};
	/omit-if-no-ref/ asclin2_tx_p32_5: asclin2_tx_p32_5 {
		pinmux = <TC3XX_OUTPUT_PINMUX(32, 5, O2)>;
		output-enable;
		pad-type = "slow";
	};
	/omit-if-no-ref/ asclin2_tx_p33_8: asclin2_tx_p33_8 {
		pinmux = <TC3XX_OUTPUT_PINMUX(33, 8, O2)>;
		output-enable;
		pad-type = "fast";
	};
	/omit-if-no-ref/ asclin2_tx_p33_9: asclin2_tx_p33_9 {
		pinmux = <TC3XX_OUTPUT_PINMUX(33, 9, O2)>;
		output-enable;
		pad-type = "slow";
	};
	/omit-if-no-ref/ asclin3_cts_p0_12: asclin3_cts_p0_12 {
		pinmux = <TC3XX_INPUT_PINMUX(0, 12, A)>;
		pin-type = <1>;
		pad-type = "slow";
	};
	/omit-if-no-ref/ asclin3_rts_p0_9: asclin3_rts_p0_9 {
		pinmux = <TC3XX_OUTPUT_PINMUX(0, 9, O3)>;
		output-enable;
		pad-type = "slow";
	};
	/omit-if-no-ref/ asclin3_rx_p0_1: asclin3_rx_p0_1 {
		pinmux = <TC3XX_INPUT_PINMUX(0, 1, E)>;
		pin-type = <0>;
		pad-type = "slow";
	};
	/omit-if-no-ref/ asclin3_rx_p11_0: asclin3_rx_p11_0 {
		pinmux = <TC3XX_INPUT_PINMUX(11, 0, B)>;
		pin-type = <0>;
		pad-type = "rfast";
	};
	/omit-if-no-ref/ asclin3_rx_p15_7: asclin3_rx_p15_7 {
		pinmux = <TC3XX_INPUT_PINMUX(15, 7, A)>;
		pin-type = <0>;
		pad-type = "fast";
	};
	/omit-if-no-ref/ asclin3_rx_p20_3: asclin3_rx_p20_3 {
		pinmux = <TC3XX_INPUT_PINMUX(20, 3, C)>;
		pin-type = <0>;
		pad-type = "slow";
	};
	/omit-if-no-ref/ asclin3_rx_p21_6: asclin3_rx_p21_6 {
		pinmux = <TC3XX_INPUT_PINMUX(21, 6, F)>;
		pin-type = <0>;
		pad-type = "fast";
	};
	/omit-if-no-ref/ asclin3_rx_p32_2: asclin3_rx_p32_2 {
		pinmux = <TC3XX_INPUT_PINMUX(32, 2, D)>;
		pin-type = <0>;
		pad-type = "slow";
	};
	/omit-if-no-ref/ asclin3_sclk_p0_0: asclin3_sclk_p0_0 {
		pinmux = <TC3XX_OUTPUT_PINMUX(0, 0, O2)>;
		output-enable;
		pad-type = "fast";
	};
	/omit-if-no-ref/ asclin3_sclk_p0_2: asclin3_sclk_p0_2 {
		pinmux = <TC3XX_OUTPUT_PINMUX(0, 2, O2)>;
		output-enable;
		pad-type = "slow";
	};
	/omit-if-no-ref/ asclin3_sclk_p11_1: asclin3_sclk_p11_1 {
		pinmux = <TC3XX_OUTPUT_PINMUX(11, 1, O2)>;
		output-enable;
		pad-type = "rfast";
	};
	/omit-if-no-ref/ asclin3_sclk_p11_4: asclin3_sclk_p11_4 {
		pinmux = <TC3XX_OUTPUT_PINMUX(11, 4, O2)>;
		output-enable;
		pad-type = "rfast";
	};
	/omit-if-no-ref/ asclin3_sclk_p15_6: asclin3_sclk_p15_6 {
		pinmux = <TC3XX_OUTPUT_PINMUX(15, 6, O6)>;
		output-enable;
		pad-type = "fast";
	};
	/omit-if-no-ref/ asclin3_sclk_p15_8: asclin3_sclk_p15_8 {
		pinmux = <TC3XX_OUTPUT_PINMUX(15, 8, O6)>;
		output-enable;
		pad-type = "fast";
	};
	/omit-if-no-ref/ asclin3_sclk_p20_0: asclin3_sclk_p20_0 {
		pinmux = <TC3XX_OUTPUT_PINMUX(20, 0, O3)>;
		output-enable;
		pad-type = "fast";
	};
	/omit-if-no-ref/ asclin3_sclk_p21_5: asclin3_sclk_p21_5 {
		pinmux = <TC3XX_OUTPUT_PINMUX(21, 5, O2)>;
		output-enable;
		pad-type = "fast";
	};
	/omit-if-no-ref/ asclin3_sclk_p21_7: asclin3_sclk_p21_7 {
		pinmux = <TC3XX_OUTPUT_PINMUX(21, 7, O3)>;
		output-enable;
		pad-type = "fast";
	};
	/omit-if-no-ref/ asclin3_sclk_p32_3: asclin3_sclk_p32_3 {
		pinmux = <TC3XX_OUTPUT_PINMUX(32, 3, O4)>;
		output-enable;
		pad-type = "slow";
	};
	/omit-if-no-ref/ asclin3_sclk_p33_2: asclin3_sclk_p33_2 {
		pinmux = <TC3XX_OUTPUT_PINMUX(33, 2, O2)>;
		output-enable;
		pad-type = "slow";
	};
	/omit-if-no-ref/ asclin3_slso_p0_3: asclin3_slso_p0_3 {
		pinmux = <TC3XX_OUTPUT_PINMUX(0, 3, O2)>;
		output-enable;
		pad-type = "slow";
	};
	/omit-if-no-ref/ asclin3_slso_p12_1: asclin3_slso_p12_1 {
		pinmux = <TC3XX_OUTPUT_PINMUX(12, 1, O2)>;
		output-enable;
		pad-type = "slow";
	};
	/omit-if-no-ref/ asclin3_slso_p14_3: asclin3_slso_p14_3 {
		pinmux = <TC3XX_OUTPUT_PINMUX(14, 3, O5)>;
		output-enable;
		pad-type = "slow";
	};
	/omit-if-no-ref/ asclin3_slso_p21_2: asclin3_slso_p21_2 {
		pinmux = <TC3XX_OUTPUT_PINMUX(21, 2, O2)>;
		output-enable;
		pad-type = "fast";
	};
	/omit-if-no-ref/ asclin3_slso_p21_6: asclin3_slso_p21_6 {
		pinmux = <TC3XX_OUTPUT_PINMUX(21, 6, O2)>;
		output-enable;
		pad-type = "fast";
	};
	/omit-if-no-ref/ asclin3_slso_p33_1: asclin3_slso_p33_1 {
		pinmux = <TC3XX_OUTPUT_PINMUX(33, 1, O2)>;
		output-enable;
		pad-type = "slow";
	};
	/omit-if-no-ref/ asclin3_tx_p0_0: asclin3_tx_p0_0 {
		pinmux = <TC3XX_OUTPUT_PINMUX(0, 0, O3)>;
		output-enable;
		pad-type = "fast";
	};
	/omit-if-no-ref/ asclin3_tx_p0_1: asclin3_tx_p0_1 {
		pinmux = <TC3XX_OUTPUT_PINMUX(0, 1, O2)>;
		output-enable;
		pad-type = "slow";
	};
	/omit-if-no-ref/ asclin3_tx_p11_0: asclin3_tx_p11_0 {
		pinmux = <TC3XX_OUTPUT_PINMUX(11, 0, O2)>;
		output-enable;
		pad-type = "rfast";
	};
	/omit-if-no-ref/ asclin3_tx_p11_1: asclin3_tx_p11_1 {
		pinmux = <TC3XX_OUTPUT_PINMUX(11, 1, O3)>;
		output-enable;
		pad-type = "rfast";
	};
	/omit-if-no-ref/ asclin3_tx_p15_6: asclin3_tx_p15_6 {
		pinmux = <TC3XX_OUTPUT_PINMUX(15, 6, O2)>;
		output-enable;
		pad-type = "fast";
	};
	/omit-if-no-ref/ asclin3_tx_p15_7: asclin3_tx_p15_7 {
		pinmux = <TC3XX_OUTPUT_PINMUX(15, 7, O2)>;
		output-enable;
		pad-type = "fast";
	};
	/omit-if-no-ref/ asclin3_tx_p20_0: asclin3_tx_p20_0 {
		pinmux = <TC3XX_OUTPUT_PINMUX(20, 0, O2)>;
		output-enable;
		pad-type = "fast";
	};
	/omit-if-no-ref/ asclin3_tx_p20_3: asclin3_tx_p20_3 {
		pinmux = <TC3XX_OUTPUT_PINMUX(20, 3, O2)>;
		output-enable;
		pad-type = "slow";
	};
	/omit-if-no-ref/ asclin3_tx_p21_7: asclin3_tx_p21_7 {
		pinmux = <TC3XX_OUTPUT_PINMUX(21, 7, O2)>;
		output-enable;
		pad-type = "fast";
	};
	/omit-if-no-ref/ asclin3_tx_p22_0: asclin3_tx_p22_0 {
		pinmux = <TC3XX_OUTPUT_PINMUX(22, 0, O2)>;
		output-enable;
		pad-type = "fast";
	};
	/omit-if-no-ref/ asclin3_tx_p22_1: asclin3_tx_p22_1 {
		pinmux = <TC3XX_OUTPUT_PINMUX(22, 1, O2)>;
		output-enable;
		pad-type = "fast";
	};
	/omit-if-no-ref/ asclin3_tx_p32_2: asclin3_tx_p32_2 {
		pinmux = <TC3XX_OUTPUT_PINMUX(32, 2, O2)>;
		output-enable;
		pad-type = "slow";
	};
	/omit-if-no-ref/ asclin3_tx_p32_3: asclin3_tx_p32_3 {
		pinmux = <TC3XX_OUTPUT_PINMUX(32, 3, O2)>;
		output-enable;
		pad-type = "slow";
	};
	/omit-if-no-ref/ asclin4_rx_p0_12: asclin4_rx_p0_12 {
		pinmux = <TC3XX_INPUT_PINMUX(0, 12, A)>;
		pin-type = <0>;
		pad-type = "slow";
	};
	/omit-if-no-ref/ asclin4_rx_p22_6: asclin4_rx_p22_6 {
		pinmux = <TC3XX_INPUT_PINMUX(22, 6, C)>;
		pin-type = <0>;
		pad-type = "slow";
	};
	/omit-if-no-ref/ asclin4_rx_p22_9: asclin4_rx_p22_9 {
		pinmux = <TC3XX_INPUT_PINMUX(22, 9, D)>;
		pin-type = <0>;
		pad-type = "slow";
	};
	/omit-if-no-ref/ asclin4_rx_p34_2: asclin4_rx_p34_2 {
		pinmux = <TC3XX_INPUT_PINMUX(34, 2, B)>;
		pin-type = <0>;
		pad-type = "slow";
	};
	/omit-if-no-ref/ asclin4_sclk_p0_10: asclin4_sclk_p0_10 {
		pinmux = <TC3XX_OUTPUT_PINMUX(0, 10, O2)>;
		output-enable;
		pad-type = "slow";
	};
	/omit-if-no-ref/ asclin4_sclk_p22_7: asclin4_sclk_p22_7 {
		pinmux = <TC3XX_OUTPUT_PINMUX(22, 7, O2)>;
		output-enable;
		pad-type = "slow";
	};
	/omit-if-no-ref/ asclin4_sclk_p34_3: asclin4_sclk_p34_3 {
		pinmux = <TC3XX_OUTPUT_PINMUX(34, 3, O2)>;
		output-enable;
		pad-type = "slow";
	};
	/omit-if-no-ref/ asclin4_slso_p0_11: asclin4_slso_p0_11 {
		pinmux = <TC3XX_OUTPUT_PINMUX(0, 11, O2)>;
		output-enable;
		pad-type = "slow";
	};
	/omit-if-no-ref/ asclin4_slso_p22_4: asclin4_slso_p22_4 {
		pinmux = <TC3XX_OUTPUT_PINMUX(22, 4, O2)>;
		output-enable;
		pad-type = "slow";
	};
	/omit-if-no-ref/ asclin4_slso_p22_11: asclin4_slso_p22_11 {
		pinmux = <TC3XX_OUTPUT_PINMUX(22, 11, O2)>;
		output-enable;
		pad-type = "rfast";
	};
	/omit-if-no-ref/ asclin4_slso_p34_4: asclin4_slso_p34_4 {
		pinmux = <TC3XX_OUTPUT_PINMUX(34, 4, O2)>;
		output-enable;
		pad-type = "slow";
	};
	/omit-if-no-ref/ asclin4_tx_p0_9: asclin4_tx_p0_9 {
		pinmux = <TC3XX_OUTPUT_PINMUX(0, 9, O5)>;
		output-enable;
		pad-type = "slow";
	};
	/omit-if-no-ref/ asclin4_tx_p22_5: asclin4_tx_p22_5 {
		pinmux = <TC3XX_OUTPUT_PINMUX(22, 5, O2)>;
		output-enable;
		pad-type = "slow";
	};
	/omit-if-no-ref/ asclin4_tx_p22_10: asclin4_tx_p22_10 {
		pinmux = <TC3XX_OUTPUT_PINMUX(22, 10, O2)>;
		output-enable;
		pad-type = "rfast";
	};
	/omit-if-no-ref/ asclin4_tx_p34_1: asclin4_tx_p34_1 {
		pinmux = <TC3XX_OUTPUT_PINMUX(34, 1, O2)>;
		output-enable;
		pad-type = "slow";
	};
	/omit-if-no-ref/ asclin5_rx_p0_6: asclin5_rx_p0_6 {
		pinmux = <TC3XX_INPUT_PINMUX(0, 6, A)>;
		pin-type = <0>;
		pad-type = "slow";
	};
	/omit-if-no-ref/ asclin5_rx_p22_3: asclin5_rx_p22_3 {
		pinmux = <TC3XX_INPUT_PINMUX(22, 3, C)>;
		pin-type = <0>;
		pad-type = "fast";
	};
	/omit-if-no-ref/ asclin5_rx_p33_4: asclin5_rx_p33_4 {
		pinmux = <TC3XX_INPUT_PINMUX(33, 4, B)>;
		pin-type = <0>;
		pad-type = "slow";
	};
	/omit-if-no-ref/ asclin5_sclk_p22_8: asclin5_sclk_p22_8 {
		pinmux = <TC3XX_OUTPUT_PINMUX(22, 8, O2)>;
		output-enable;
		pad-type = "slow";
	};
	/omit-if-no-ref/ asclin5_sclk_p33_3: asclin5_sclk_p33_3 {
		pinmux = <TC3XX_OUTPUT_PINMUX(33, 3, O2)>;
		output-enable;
		pad-type = "slow";
	};
	/omit-if-no-ref/ asclin5_slso_p14_8: asclin5_slso_p14_8 {
		pinmux = <TC3XX_OUTPUT_PINMUX(14, 8, O2)>;
		output-enable;
		pad-type = "slow";
	};
	/omit-if-no-ref/ asclin5_slso_p33_5: asclin5_slso_p33_5 {
		pinmux = <TC3XX_OUTPUT_PINMUX(33, 5, O7)>;
		output-enable;
		pad-type = "slow";
	};
	/omit-if-no-ref/ asclin5_tx_p0_7: asclin5_tx_p0_7 {
		pinmux = <TC3XX_OUTPUT_PINMUX(0, 7, O2)>;
		output-enable;
		pad-type = "slow";
	};
	/omit-if-no-ref/ asclin5_tx_p22_2: asclin5_tx_p22_2 {
		pinmux = <TC3XX_OUTPUT_PINMUX(22, 2, O2)>;
		output-enable;
		pad-type = "fast";
	};
	/omit-if-no-ref/ asclin5_tx_p33_0: asclin5_tx_p33_0 {
		pinmux = <TC3XX_OUTPUT_PINMUX(33, 0, O2)>;
		output-enable;
		pad-type = "slow";
	};
	/omit-if-no-ref/ asclin6_rx_p22_0: asclin6_rx_p22_0 {
		pinmux = <TC3XX_INPUT_PINMUX(22, 0, E)>;
		pin-type = <0>;
		pad-type = "fast";
	};
	/omit-if-no-ref/ asclin6_rx_p23_1: asclin6_rx_p23_1 {
		pinmux = <TC3XX_INPUT_PINMUX(23, 1, F)>;
		pin-type = <0>;
		pad-type = "fast";
	};
	/omit-if-no-ref/ asclin6_rx_p23_3: asclin6_rx_p23_3 {
		pinmux = <TC3XX_INPUT_PINMUX(23, 3, A)>;
		pin-type = <0>;
		pad-type = "rfast";
	};
	/omit-if-no-ref/ asclin6_rx_p32_6: asclin6_rx_p32_6 {
		pinmux = <TC3XX_INPUT_PINMUX(32, 6, C)>;
		pin-type = <0>;
		pad-type = "slow";
	};
	/omit-if-no-ref/ asclin6_sclk_p23_1: asclin6_sclk_p23_1 {
		pinmux = <TC3XX_OUTPUT_PINMUX(23, 1, O7)>;
		output-enable;
		pad-type = "fast";
	};
	/omit-if-no-ref/ asclin6_slso_p23_4: asclin6_slso_p23_4 {
		pinmux = <TC3XX_OUTPUT_PINMUX(23, 4, O2)>;
		output-enable;
		pad-type = "rfast";
	};
	/omit-if-no-ref/ asclin6_tx_p22_0: asclin6_tx_p22_0 {
		pinmux = <TC3XX_OUTPUT_PINMUX(22, 0, O7)>;
		output-enable;
		pad-type = "fast";
	};
	/omit-if-no-ref/ asclin6_tx_p23_5: asclin6_tx_p23_5 {
		pinmux = <TC3XX_OUTPUT_PINMUX(23, 5, O2)>;
		output-enable;
		pad-type = "fast";
	};
	/omit-if-no-ref/ asclin6_tx_p32_7: asclin6_tx_p32_7 {
		pinmux = <TC3XX_OUTPUT_PINMUX(32, 7, O2)>;
		output-enable;
		pad-type = "slow";
	};
	/omit-if-no-ref/ asclin7_rx_p22_1: asclin7_rx_p22_1 {
		pinmux = <TC3XX_INPUT_PINMUX(22, 1, E)>;
		pin-type = <0>;
		pad-type = "fast";
	};
	/omit-if-no-ref/ asclin7_rx_p22_4: asclin7_rx_p22_4 {
		pinmux = <TC3XX_INPUT_PINMUX(22, 4, F)>;
		pin-type = <0>;
		pad-type = "slow";
	};
	/omit-if-no-ref/ asclin7_rx_p23_2: asclin7_rx_p23_2 {
		pinmux = <TC3XX_INPUT_PINMUX(23, 2, C)>;
		pin-type = <0>;
		pad-type = "rfast";
	};
	/omit-if-no-ref/ asclin7_slso_p14_8: asclin7_slso_p14_8 {
		pinmux = <TC3XX_OUTPUT_PINMUX(14, 8, O3)>;
		output-enable;
		pad-type = "slow";
	};
	/omit-if-no-ref/ asclin7_tx_p22_1: asclin7_tx_p22_1 {
		pinmux = <TC3XX_OUTPUT_PINMUX(22, 1, O7)>;
		output-enable;
		pad-type = "fast";
	};
	/omit-if-no-ref/ asclin7_tx_p23_3: asclin7_tx_p23_3 {
		pinmux = <TC3XX_OUTPUT_PINMUX(23, 3, O2)>;
		output-enable;
		pad-type = "rfast";
	};
	/omit-if-no-ref/ asclin8_rx_p2_9: asclin8_rx_p2_9 {
		pinmux = <TC3XX_INPUT_PINMUX(2, 9, A)>;
		pin-type = <0>;
		pad-type = "slow";
	};
	/omit-if-no-ref/ asclin8_rx_p2_10: asclin8_rx_p2_10 {
		pinmux = <TC3XX_INPUT_PINMUX(2, 10, B)>;
		pin-type = <0>;
		pad-type = "slow";
	};
	/omit-if-no-ref/ asclin8_rx_p33_1: asclin8_rx_p33_1 {
		pinmux = <TC3XX_INPUT_PINMUX(33, 1, C)>;
		pin-type = <0>;
		pad-type = "slow";
	};
	/omit-if-no-ref/ asclin8_rx_p33_6: asclin8_rx_p33_6 {
		pinmux = <TC3XX_INPUT_PINMUX(33, 6, D)>;
		pin-type = <0>;
		pad-type = "slow";
	};
	/omit-if-no-ref/ asclin8_rx_p34_5: asclin8_rx_p34_5 {
		pinmux = <TC3XX_INPUT_PINMUX(34, 5, E)>;
		pin-type = <0>;
		pad-type = "fast";
	};
	/omit-if-no-ref/ asclin8_sclk_p2_8: asclin8_sclk_p2_8 {
		pinmux = <TC3XX_OUTPUT_PINMUX(2, 8, O3)>;
		output-enable;
		pad-type = "slow";
	};
	/omit-if-no-ref/ asclin8_slso_p2_11: asclin8_slso_p2_11 {
		pinmux = <TC3XX_OUTPUT_PINMUX(2, 11, O3)>;
		output-enable;
		pad-type = "slow";
	};
	/omit-if-no-ref/ asclin8_tx_p2_9: asclin8_tx_p2_9 {
		pinmux = <TC3XX_OUTPUT_PINMUX(2, 9, O3)>;
		output-enable;
		pad-type = "slow";
	};
	/omit-if-no-ref/ asclin8_tx_p33_7: asclin8_tx_p33_7 {
		pinmux = <TC3XX_OUTPUT_PINMUX(33, 7, O4)>;
		output-enable;
		pad-type = "slow";
	};
	/omit-if-no-ref/ asclin8_tx_p34_5: asclin8_tx_p34_5 {
		pinmux = <TC3XX_OUTPUT_PINMUX(34, 5, O2)>;
		output-enable;
		pad-type = "fast";
	};
	/omit-if-no-ref/ asclin9_rx_p1_5: asclin9_rx_p1_5 {
		pinmux = <TC3XX_INPUT_PINMUX(1, 5, A)>;
		pin-type = <0>;
		pad-type = "slow";
	};
	/omit-if-no-ref/ asclin9_rx_p1_7: asclin9_rx_p1_7 {
		pinmux = <TC3XX_INPUT_PINMUX(1, 7, B)>;
		pin-type = <0>;
		pad-type = "fast";
	};
	/omit-if-no-ref/ asclin9_rx_p14_7: asclin9_rx_p14_7 {
		pinmux = <TC3XX_INPUT_PINMUX(14, 7, C)>;
		pin-type = <0>;
		pad-type = "slow";
	};
	/omit-if-no-ref/ asclin9_rx_p14_9: asclin9_rx_p14_9 {
		pinmux = <TC3XX_INPUT_PINMUX(14, 9, D)>;
		pin-type = <0>;
		pad-type = "fast";
	};
	/omit-if-no-ref/ asclin9_rx_p20_6: asclin9_rx_p20_6 {
		pinmux = <TC3XX_INPUT_PINMUX(20, 6, E)>;
		pin-type = <0>;
		pad-type = "slow";
	};
	/omit-if-no-ref/ asclin9_rx_p20_7: asclin9_rx_p20_7 {
		pinmux = <TC3XX_INPUT_PINMUX(20, 7, F)>;
		pin-type = <0>;
		pad-type = "fast";
	};
	/omit-if-no-ref/ asclin9_sclk_p1_6: asclin9_sclk_p1_6 {
		pinmux = <TC3XX_OUTPUT_PINMUX(1, 6, O3)>;
		output-enable;
		pad-type = "fast";
	};
	/omit-if-no-ref/ asclin9_slso_p1_4: asclin9_slso_p1_4 {
		pinmux = <TC3XX_OUTPUT_PINMUX(1, 4, O3)>;
		output-enable;
		pad-type = "slow";
	};
	/omit-if-no-ref/ asclin9_tx_p1_7: asclin9_tx_p1_7 {
		pinmux = <TC3XX_OUTPUT_PINMUX(1, 7, O3)>;
		output-enable;
		pad-type = "fast";
	};
	/omit-if-no-ref/ asclin9_tx_p14_7: asclin9_tx_p14_7 {
		pinmux = <TC3XX_OUTPUT_PINMUX(14, 7, O4)>;
		output-enable;
		pad-type = "slow";
	};
	/omit-if-no-ref/ asclin9_tx_p20_7: asclin9_tx_p20_7 {
		pinmux = <TC3XX_OUTPUT_PINMUX(20, 7, O2)>;
		output-enable;
		pad-type = "fast";
	};
	/omit-if-no-ref/ asclin10_rx_p0_4: asclin10_rx_p0_4 {
		pinmux = <TC3XX_INPUT_PINMUX(0, 4, A)>;
		pin-type = <0>;
		pad-type = "slow";
	};
	/omit-if-no-ref/ asclin10_rx_p0_8: asclin10_rx_p0_8 {
		pinmux = <TC3XX_INPUT_PINMUX(0, 8, B)>;
		pin-type = <0>;
		pad-type = "slow";
	};
	/omit-if-no-ref/ asclin10_rx_p13_0: asclin10_rx_p13_0 {
		pinmux = <TC3XX_INPUT_PINMUX(13, 0, C)>;
		pin-type = <0>;
		pad-type = "fast";
	};
	/omit-if-no-ref/ asclin10_rx_p13_1: asclin10_rx_p13_1 {
		pinmux = <TC3XX_INPUT_PINMUX(13, 1, D)>;
		pin-type = <0>;
		pad-type = "fast";
	};
	/omit-if-no-ref/ asclin10_sclk_p13_2: asclin10_sclk_p13_2 {
		pinmux = <TC3XX_OUTPUT_PINMUX(13, 2, O2)>;
		output-enable;
		pad-type = "fast";
	};
	/omit-if-no-ref/ asclin10_slso_p13_3: asclin10_slso_p13_3 {
		pinmux = <TC3XX_OUTPUT_PINMUX(13, 3, O2)>;
		output-enable;
		pad-type = "fast";
	};
	/omit-if-no-ref/ asclin10_tx_p0_8: asclin10_tx_p0_8 {
		pinmux = <TC3XX_OUTPUT_PINMUX(0, 8, O3)>;
		output-enable;
		pad-type = "slow";
	};
	/omit-if-no-ref/ asclin10_tx_p13_0: asclin10_tx_p13_0 {
		pinmux = <TC3XX_OUTPUT_PINMUX(13, 0, O2)>;
		output-enable;
		pad-type = "fast";
	};
	/omit-if-no-ref/ asclin11_rx_p10_0: asclin11_rx_p10_0 {
		pinmux = <TC3XX_INPUT_PINMUX(10, 0, A)>;
		pin-type = <0>;
		pad-type = "slow";
	};
	/omit-if-no-ref/ asclin11_rx_p10_4: asclin11_rx_p10_4 {
		pinmux = <TC3XX_INPUT_PINMUX(10, 4, B)>;
		pin-type = <0>;
		pad-type = "fast";
	};
	/omit-if-no-ref/ asclin11_rx_p21_0: asclin11_rx_p21_0 {
		pinmux = <TC3XX_INPUT_PINMUX(21, 0, C)>;
		pin-type = <0>;
		pad-type = "fast";
	};
	/omit-if-no-ref/ asclin11_rx_p21_1: asclin11_rx_p21_1 {
		pinmux = <TC3XX_INPUT_PINMUX(21, 1, D)>;
		pin-type = <0>;
		pad-type = "fast";
	};
	/omit-if-no-ref/ asclin11_rx_p21_2: asclin11_rx_p21_2 {
		pinmux = <TC3XX_INPUT_PINMUX(21, 2, E)>;
		pin-type = <0>;
		pad-type = "fast";
	};
	/omit-if-no-ref/ asclin11_rx_p21_5: asclin11_rx_p21_5 {
		pinmux = <TC3XX_INPUT_PINMUX(21, 5, F)>;
		pin-type = <0>;
		pad-type = "fast";
	};
	/omit-if-no-ref/ asclin11_sclk_p21_3: asclin11_sclk_p21_3 {
		pinmux = <TC3XX_OUTPUT_PINMUX(21, 3, O2)>;
		output-enable;
		pad-type = "fast";
	};
	/omit-if-no-ref/ asclin11_slso_p21_4: asclin11_slso_p21_4 {
		pinmux = <TC3XX_OUTPUT_PINMUX(21, 4, O2)>;
		output-enable;
		pad-type = "fast";
	};
	/omit-if-no-ref/ asclin11_tx_p10_0: asclin11_tx_p10_0 {
		pinmux = <TC3XX_OUTPUT_PINMUX(10, 0, O2)>;
		output-enable;
		pad-type = "slow";
	};
	/omit-if-no-ref/ asclin11_tx_p21_0: asclin11_tx_p21_0 {
		pinmux = <TC3XX_OUTPUT_PINMUX(21, 0, O2)>;
		output-enable;
		pad-type = "fast";
	};
	/omit-if-no-ref/ asclin11_tx_p21_5: asclin11_tx_p21_5 {
		pinmux = <TC3XX_OUTPUT_PINMUX(21, 5, O3)>;
		output-enable;
		pad-type = "fast";
	};
	/omit-if-no-ref/ can00_rx_p2_1: can00_rx_p2_1 {
		pinmux = <TC3XX_INPUT_PINMUX(2, 1, A)>;
		pin-type = <0>;
		pad-type = "slow";
	};
	/omit-if-no-ref/ can00_rx_p12_0: can00_rx_p12_0 {
		pinmux = <TC3XX_INPUT_PINMUX(12, 0, C)>;
		pin-type = <0>;
		pad-type = "slow";
	};
	/omit-if-no-ref/ can00_rx_p20_7: can00_rx_p20_7 {
		pinmux = <TC3XX_INPUT_PINMUX(20, 7, B)>;
		pin-type = <0>;
		pad-type = "fast";
	};
	/omit-if-no-ref/ can00_rx_p33_7: can00_rx_p33_7 {
		pinmux = <TC3XX_INPUT_PINMUX(33, 7, E)>;
		pin-type = <0>;
		pad-type = "slow";
	};
	/omit-if-no-ref/ can00_rx_p33_12: can00_rx_p33_12 {
		pinmux = <TC3XX_INPUT_PINMUX(33, 12, D)>;
		pin-type = <0>;
		pad-type = "fast";
	};
	/omit-if-no-ref/ can00_rx_p34_2: can00_rx_p34_2 {
		pinmux = <TC3XX_INPUT_PINMUX(34, 2, G)>;
		pin-type = <0>;
		pad-type = "slow";
	};
	/omit-if-no-ref/ can00_tx_p2_0: can00_tx_p2_0 {
		pinmux = <TC3XX_OUTPUT_PINMUX(2, 0, O5)>;
		output-enable;
		pad-type = "fast";
	};
	/omit-if-no-ref/ can00_tx_p12_1: can00_tx_p12_1 {
		pinmux = <TC3XX_OUTPUT_PINMUX(12, 1, O5)>;
		output-enable;
		pad-type = "slow";
	};
	/omit-if-no-ref/ can00_tx_p20_8: can00_tx_p20_8 {
		pinmux = <TC3XX_OUTPUT_PINMUX(20, 8, O5)>;
		output-enable;
		pad-type = "fast";
	};
	/omit-if-no-ref/ can00_tx_p33_8: can00_tx_p33_8 {
		pinmux = <TC3XX_OUTPUT_PINMUX(33, 8, O5)>;
		output-enable;
		pad-type = "fast";
	};
	/omit-if-no-ref/ can00_tx_p33_13: can00_tx_p33_13 {
		pinmux = <TC3XX_OUTPUT_PINMUX(33, 13, O5)>;
		output-enable;
		pad-type = "fast";
	};
	/omit-if-no-ref/ can00_tx_p34_1: can00_tx_p34_1 {
		pinmux = <TC3XX_OUTPUT_PINMUX(34, 1, O4)>;
		output-enable;
		pad-type = "slow";
	};
	/omit-if-no-ref/ can01_rx_p1_4: can01_rx_p1_4 {
		pinmux = <TC3XX_INPUT_PINMUX(1, 4, C)>;
		pin-type = <0>;
		pad-type = "slow";
	};
	/omit-if-no-ref/ can01_rx_p2_10: can01_rx_p2_10 {
		pinmux = <TC3XX_INPUT_PINMUX(2, 10, E)>;
		pin-type = <0>;
		pad-type = "slow";
	};
	/omit-if-no-ref/ can01_rx_p14_1: can01_rx_p14_1 {
		pinmux = <TC3XX_INPUT_PINMUX(14, 1, B)>;
		pin-type = <0>;
		pad-type = "fast";
	};
	/omit-if-no-ref/ can01_rx_p15_3: can01_rx_p15_3 {
		pinmux = <TC3XX_INPUT_PINMUX(15, 3, A)>;
		pin-type = <0>;
		pad-type = "fast";
	};
	/omit-if-no-ref/ can01_rx_p33_10: can01_rx_p33_10 {
		pinmux = <TC3XX_INPUT_PINMUX(33, 10, D)>;
		pin-type = <0>;
		pad-type = "fast";
	};
	/omit-if-no-ref/ can01_tx_p1_3: can01_tx_p1_3 {
		pinmux = <TC3XX_OUTPUT_PINMUX(1, 3, O5)>;
		output-enable;
		pad-type = "slow";
	};
	/omit-if-no-ref/ can01_tx_p2_9: can01_tx_p2_9 {
		pinmux = <TC3XX_OUTPUT_PINMUX(2, 9, O5)>;
		output-enable;
		pad-type = "slow";
	};
	/omit-if-no-ref/ can01_tx_p14_0: can01_tx_p14_0 {
		pinmux = <TC3XX_OUTPUT_PINMUX(14, 0, O5)>;
		output-enable;
		pad-type = "fast";
	};
	/omit-if-no-ref/ can01_tx_p15_2: can01_tx_p15_2 {
		pinmux = <TC3XX_OUTPUT_PINMUX(15, 2, O5)>;
		output-enable;
		pad-type = "fast";
	};
	/omit-if-no-ref/ can01_tx_p33_9: can01_tx_p33_9 {
		pinmux = <TC3XX_OUTPUT_PINMUX(33, 9, O5)>;
		output-enable;
		pad-type = "slow";
	};
	/omit-if-no-ref/ can02_rx_p2_3: can02_rx_p2_3 {
		pinmux = <TC3XX_INPUT_PINMUX(2, 3, B)>;
		pin-type = <0>;
		pad-type = "slow";
	};
	/omit-if-no-ref/ can02_rx_p10_2: can02_rx_p10_2 {
		pinmux = <TC3XX_INPUT_PINMUX(10, 2, E)>;
		pin-type = <0>;
		pad-type = "fast";
	};
	/omit-if-no-ref/ can02_rx_p14_8: can02_rx_p14_8 {
		pinmux = <TC3XX_INPUT_PINMUX(14, 8, D)>;
		pin-type = <0>;
		pad-type = "slow";
	};
	/omit-if-no-ref/ can02_rx_p15_1: can02_rx_p15_1 {
		pinmux = <TC3XX_INPUT_PINMUX(15, 1, A)>;
		pin-type = <0>;
		pad-type = "fast";
	};
	/omit-if-no-ref/ can02_rx_p32_6: can02_rx_p32_6 {
		pinmux = <TC3XX_INPUT_PINMUX(32, 6, C)>;
		pin-type = <0>;
		pad-type = "slow";
	};
	/omit-if-no-ref/ can02_tx_p2_2: can02_tx_p2_2 {
		pinmux = <TC3XX_OUTPUT_PINMUX(2, 2, O5)>;
		output-enable;
		pad-type = "fast";
	};
	/omit-if-no-ref/ can02_tx_p10_3: can02_tx_p10_3 {
		pinmux = <TC3XX_OUTPUT_PINMUX(10, 3, O6)>;
		output-enable;
		pad-type = "fast";
	};
	/omit-if-no-ref/ can02_tx_p14_10: can02_tx_p14_10 {
		pinmux = <TC3XX_OUTPUT_PINMUX(14, 10, O5)>;
		output-enable;
		pad-type = "fast";
	};
	/omit-if-no-ref/ can02_tx_p15_0: can02_tx_p15_0 {
		pinmux = <TC3XX_OUTPUT_PINMUX(15, 0, O5)>;
		output-enable;
		pad-type = "fast";
	};
	/omit-if-no-ref/ can02_tx_p32_5: can02_tx_p32_5 {
		pinmux = <TC3XX_OUTPUT_PINMUX(32, 5, O6)>;
		output-enable;
		pad-type = "slow";
	};
	/omit-if-no-ref/ can03_rx_p0_3: can03_rx_p0_3 {
		pinmux = <TC3XX_INPUT_PINMUX(0, 3, A)>;
		pin-type = <0>;
		pad-type = "slow";
	};
	/omit-if-no-ref/ can03_rx_p11_10: can03_rx_p11_10 {
		pinmux = <TC3XX_INPUT_PINMUX(11, 10, D)>;
		pin-type = <0>;
		pad-type = "fast";
	};
	/omit-if-no-ref/ can03_rx_p20_0: can03_rx_p20_0 {
		pinmux = <TC3XX_INPUT_PINMUX(20, 0, C)>;
		pin-type = <0>;
		pad-type = "fast";
	};
	/omit-if-no-ref/ can03_rx_p20_9: can03_rx_p20_9 {
		pinmux = <TC3XX_INPUT_PINMUX(20, 9, E)>;
		pin-type = <0>;
		pad-type = "fast";
	};
	/omit-if-no-ref/ can03_rx_p32_2: can03_rx_p32_2 {
		pinmux = <TC3XX_INPUT_PINMUX(32, 2, B)>;
		pin-type = <0>;
		pad-type = "slow";
	};
	/omit-if-no-ref/ can03_tx_p0_2: can03_tx_p0_2 {
		pinmux = <TC3XX_OUTPUT_PINMUX(0, 2, O5)>;
		output-enable;
		pad-type = "slow";
	};
	/omit-if-no-ref/ can03_tx_p11_12: can03_tx_p11_12 {
		pinmux = <TC3XX_OUTPUT_PINMUX(11, 12, O5)>;
		output-enable;
		pad-type = "fast";
	};
	/omit-if-no-ref/ can03_tx_p20_3: can03_tx_p20_3 {
		pinmux = <TC3XX_OUTPUT_PINMUX(20, 3, O5)>;
		output-enable;
		pad-type = "slow";
	};
	/omit-if-no-ref/ can03_tx_p20_10: can03_tx_p20_10 {
		pinmux = <TC3XX_OUTPUT_PINMUX(20, 10, O5)>;
		output-enable;
		pad-type = "fast";
	};
	/omit-if-no-ref/ can03_tx_p32_3: can03_tx_p32_3 {
		pinmux = <TC3XX_OUTPUT_PINMUX(32, 3, O5)>;
		output-enable;
		pad-type = "slow";
	};
	/omit-if-no-ref/ can10_rx_p0_1: can10_rx_p0_1 {
		pinmux = <TC3XX_INPUT_PINMUX(0, 1, A)>;
		pin-type = <0>;
		pad-type = "slow";
	};
	/omit-if-no-ref/ can10_rx_p13_1: can10_rx_p13_1 {
		pinmux = <TC3XX_INPUT_PINMUX(13, 1, D)>;
		pin-type = <0>;
		pad-type = "fast";
	};
	/omit-if-no-ref/ can10_rx_p14_7: can10_rx_p14_7 {
		pinmux = <TC3XX_INPUT_PINMUX(14, 7, B)>;
		pin-type = <0>;
		pad-type = "slow";
	};
	/omit-if-no-ref/ can10_tx_p0_0: can10_tx_p0_0 {
		pinmux = <TC3XX_OUTPUT_PINMUX(0, 0, O5)>;
		output-enable;
		pad-type = "fast";
	};
	/omit-if-no-ref/ can10_tx_p13_0: can10_tx_p13_0 {
		pinmux = <TC3XX_OUTPUT_PINMUX(13, 0, O7)>;
		output-enable;
		pad-type = "fast";
	};
	/omit-if-no-ref/ can10_tx_p14_9: can10_tx_p14_9 {
		pinmux = <TC3XX_OUTPUT_PINMUX(14, 9, O4)>;
		output-enable;
		pad-type = "fast";
	};
	/omit-if-no-ref/ can10_tx_p23_1: can10_tx_p23_1 {
		pinmux = <TC3XX_OUTPUT_PINMUX(23, 1, O5)>;
		output-enable;
		pad-type = "fast";
	};
	/omit-if-no-ref/ can11_rx_p0_5: can11_rx_p0_5 {
		pinmux = <TC3XX_INPUT_PINMUX(0, 5, B)>;
		pin-type = <0>;
		pad-type = "slow";
	};
	/omit-if-no-ref/ can11_rx_p2_4: can11_rx_p2_4 {
		pinmux = <TC3XX_INPUT_PINMUX(2, 4, A)>;
		pin-type = <0>;
		pad-type = "fast";
	};
	/omit-if-no-ref/ can11_rx_p11_7: can11_rx_p11_7 {
		pinmux = <TC3XX_INPUT_PINMUX(11, 7, D)>;
		pin-type = <0>;
		pad-type = "slow";
	};
	/omit-if-no-ref/ can11_rx_p23_7: can11_rx_p23_7 {
		pinmux = <TC3XX_INPUT_PINMUX(23, 7, C)>;
		pin-type = <0>;
		pad-type = "slow";
	};
	/omit-if-no-ref/ can11_tx_p0_4: can11_tx_p0_4 {
		pinmux = <TC3XX_OUTPUT_PINMUX(0, 4, O3)>;
		output-enable;
		pad-type = "slow";
	};
	/omit-if-no-ref/ can11_tx_p2_5: can11_tx_p2_5 {
		pinmux = <TC3XX_OUTPUT_PINMUX(2, 5, O2)>;
		output-enable;
		pad-type = "fast";
	};
	/omit-if-no-ref/ can11_tx_p11_0: can11_tx_p11_0 {
		pinmux = <TC3XX_OUTPUT_PINMUX(11, 0, O5)>;
		output-enable;
		pad-type = "rfast";
	};
	/omit-if-no-ref/ can11_tx_p23_6: can11_tx_p23_6 {
		pinmux = <TC3XX_OUTPUT_PINMUX(23, 6, O5)>;
		output-enable;
		pad-type = "slow";
	};
	/omit-if-no-ref/ can12_rx_p10_8: can12_rx_p10_8 {
		pinmux = <TC3XX_INPUT_PINMUX(10, 8, B)>;
		pin-type = <0>;
		pad-type = "slow";
	};
	/omit-if-no-ref/ can12_rx_p11_8: can12_rx_p11_8 {
		pinmux = <TC3XX_INPUT_PINMUX(11, 8, D)>;
		pin-type = <0>;
		pad-type = "slow";
	};
	/omit-if-no-ref/ can12_rx_p20_6: can12_rx_p20_6 {
		pinmux = <TC3XX_INPUT_PINMUX(20, 6, A)>;
		pin-type = <0>;
		pad-type = "slow";
	};
	/omit-if-no-ref/ can12_rx_p23_3: can12_rx_p23_3 {
		pinmux = <TC3XX_INPUT_PINMUX(23, 3, C)>;
		pin-type = <0>;
		pad-type = "rfast";
	};
	/omit-if-no-ref/ can12_tx_p10_7: can12_tx_p10_7 {
		pinmux = <TC3XX_OUTPUT_PINMUX(10, 7, O6)>;
		output-enable;
		pad-type = "slow";
	};
	/omit-if-no-ref/ can12_tx_p11_1: can12_tx_p11_1 {
		pinmux = <TC3XX_OUTPUT_PINMUX(11, 1, O5)>;
		output-enable;
		pad-type = "rfast";
	};
	/omit-if-no-ref/ can12_tx_p20_7: can12_tx_p20_7 {
		pinmux = <TC3XX_OUTPUT_PINMUX(20, 7, O5)>;
		output-enable;
		pad-type = "fast";
	};
	/omit-if-no-ref/ can12_tx_p23_2: can12_tx_p23_2 {
		pinmux = <TC3XX_OUTPUT_PINMUX(23, 2, O5)>;
		output-enable;
		pad-type = "rfast";
	};
	/omit-if-no-ref/ can13_rx_p11_13: can13_rx_p11_13 {
		pinmux = <TC3XX_INPUT_PINMUX(11, 13, D)>;
		pin-type = <0>;
		pad-type = "slow";
	};
	/omit-if-no-ref/ can13_rx_p14_7: can13_rx_p14_7 {
		pinmux = <TC3XX_INPUT_PINMUX(14, 7, A)>;
		pin-type = <0>;
		pad-type = "slow";
	};
	/omit-if-no-ref/ can13_rx_p22_5: can13_rx_p22_5 {
		pinmux = <TC3XX_INPUT_PINMUX(22, 5, C)>;
		pin-type = <0>;
		pad-type = "slow";
	};
	/omit-if-no-ref/ can13_rx_p33_5: can13_rx_p33_5 {
		pinmux = <TC3XX_INPUT_PINMUX(33, 5, B)>;
		pin-type = <0>;
		pad-type = "slow";
	};
	/omit-if-no-ref/ can13_tx_p11_4: can13_tx_p11_4 {
		pinmux = <TC3XX_OUTPUT_PINMUX(11, 4, O5)>;
		output-enable;
		pad-type = "rfast";
	};
	/omit-if-no-ref/ can13_tx_p14_6: can13_tx_p14_6 {
		pinmux = <TC3XX_OUTPUT_PINMUX(14, 6, O4)>;
		output-enable;
		pad-type = "fast";
	};
	/omit-if-no-ref/ can13_tx_p22_4: can13_tx_p22_4 {
		pinmux = <TC3XX_OUTPUT_PINMUX(22, 4, O6)>;
		output-enable;
		pad-type = "slow";
	};
	/omit-if-no-ref/ can13_tx_p33_4: can13_tx_p33_4 {
		pinmux = <TC3XX_OUTPUT_PINMUX(33, 4, O7)>;
		output-enable;
		pad-type = "slow";
	};
	/omit-if-no-ref/ can20_rx_p10_5: can20_rx_p10_5 {
		pinmux = <TC3XX_INPUT_PINMUX(10, 5, A)>;
		pin-type = <0>;
		pad-type = "slow";
	};
	/omit-if-no-ref/ can20_rx_p10_8: can20_rx_p10_8 {
		pinmux = <TC3XX_INPUT_PINMUX(10, 8, B)>;
		pin-type = <0>;
		pad-type = "slow";
	};
	/omit-if-no-ref/ can20_rx_p11_14: can20_rx_p11_14 {
		pinmux = <TC3XX_INPUT_PINMUX(11, 14, F)>;
		pin-type = <0>;
		pad-type = "slow";
	};
	/omit-if-no-ref/ can20_rx_p34_2: can20_rx_p34_2 {
		pinmux = <TC3XX_INPUT_PINMUX(34, 2, C)>;
		pin-type = <0>;
		pad-type = "slow";
	};
	/omit-if-no-ref/ can20_tx_p10_6: can20_tx_p10_6 {
		pinmux = <TC3XX_OUTPUT_PINMUX(10, 6, O5)>;
		output-enable;
		pad-type = "slow";
	};
	/omit-if-no-ref/ can20_tx_p10_7: can20_tx_p10_7 {
		pinmux = <TC3XX_OUTPUT_PINMUX(10, 7, O5)>;
		output-enable;
		pad-type = "slow";
	};
	/omit-if-no-ref/ can20_tx_p11_5: can20_tx_p11_5 {
		pinmux = <TC3XX_OUTPUT_PINMUX(11, 5, O5)>;
		output-enable;
		pad-type = "slow";
	};
	/omit-if-no-ref/ can20_tx_p34_1: can20_tx_p34_1 {
		pinmux = <TC3XX_OUTPUT_PINMUX(34, 1, O5)>;
		output-enable;
		pad-type = "slow";
	};
	/omit-if-no-ref/ can21_rx_p0_3: can21_rx_p0_3 {
		pinmux = <TC3XX_INPUT_PINMUX(0, 3, A)>;
		pin-type = <0>;
		pad-type = "slow";
	};
	/omit-if-no-ref/ can21_rx_p20_0: can21_rx_p20_0 {
		pinmux = <TC3XX_INPUT_PINMUX(20, 0, C)>;
		pin-type = <0>;
		pad-type = "fast";
	};
	/omit-if-no-ref/ can21_rx_p22_7: can21_rx_p22_7 {
		pinmux = <TC3XX_INPUT_PINMUX(22, 7, F)>;
		pin-type = <0>;
		pad-type = "slow";
	};
	/omit-if-no-ref/ can21_rx_p32_2: can21_rx_p32_2 {
		pinmux = <TC3XX_INPUT_PINMUX(32, 2, D)>;
		pin-type = <0>;
		pad-type = "slow";
	};
	/omit-if-no-ref/ can21_tx_p0_2: can21_tx_p0_2 {
		pinmux = <TC3XX_OUTPUT_PINMUX(0, 2, O3)>;
		output-enable;
		pad-type = "slow";
	};
	/omit-if-no-ref/ can21_tx_p20_3: can21_tx_p20_3 {
		pinmux = <TC3XX_OUTPUT_PINMUX(20, 3, O6)>;
		output-enable;
		pad-type = "slow";
	};
	/omit-if-no-ref/ can21_tx_p22_6: can21_tx_p22_6 {
		pinmux = <TC3XX_OUTPUT_PINMUX(22, 6, O5)>;
		output-enable;
		pad-type = "slow";
	};
	/omit-if-no-ref/ can21_tx_p32_3: can21_tx_p32_3 {
		pinmux = <TC3XX_OUTPUT_PINMUX(32, 3, O6)>;
		output-enable;
		pad-type = "slow";
	};
	/omit-if-no-ref/ can22_rx_p22_9: can22_rx_p22_9 {
		pinmux = <TC3XX_INPUT_PINMUX(22, 9, E)>;
		pin-type = <0>;
		pad-type = "slow";
	};
	/omit-if-no-ref/ can22_rx_p23_6: can22_rx_p23_6 {
		pinmux = <TC3XX_INPUT_PINMUX(23, 6, C)>;
		pin-type = <0>;
		pad-type = "slow";
	};
	/omit-if-no-ref/ can22_rx_p32_7: can22_rx_p32_7 {
		pinmux = <TC3XX_INPUT_PINMUX(32, 7, B)>;
		pin-type = <0>;
		pad-type = "slow";
	};
	/omit-if-no-ref/ can22_rx_p33_13: can22_rx_p33_13 {
		pinmux = <TC3XX_INPUT_PINMUX(33, 13, A)>;
		pin-type = <0>;
		pad-type = "fast";
	};
	/omit-if-no-ref/ can22_tx_p22_8: can22_tx_p22_8 {
		pinmux = <TC3XX_OUTPUT_PINMUX(22, 8, O5)>;
		output-enable;
		pad-type = "slow";
	};
	/omit-if-no-ref/ can22_tx_p23_5: can22_tx_p23_5 {
		pinmux = <TC3XX_OUTPUT_PINMUX(23, 5, O6)>;
		output-enable;
		pad-type = "fast";
	};
	/omit-if-no-ref/ can22_tx_p32_6: can22_tx_p32_6 {
		pinmux = <TC3XX_OUTPUT_PINMUX(32, 6, O5)>;
		output-enable;
		pad-type = "slow";
	};
	/omit-if-no-ref/ can22_tx_p33_12: can22_tx_p33_12 {
		pinmux = <TC3XX_OUTPUT_PINMUX(33, 12, O5)>;
		output-enable;
		pad-type = "fast";
	};
	/omit-if-no-ref/ can23_rx_p14_10: can23_rx_p14_10 {
		pinmux = <TC3XX_INPUT_PINMUX(14, 10, A)>;
		pin-type = <0>;
		pad-type = "fast";
	};
	/omit-if-no-ref/ can23_rx_p22_11: can23_rx_p22_11 {
		pinmux = <TC3XX_INPUT_PINMUX(22, 11, E)>;
		pin-type = <0>;
		pad-type = "rfast";
	};
	/omit-if-no-ref/ can23_rx_p23_3: can23_rx_p23_3 {
		pinmux = <TC3XX_INPUT_PINMUX(23, 3, B)>;
		pin-type = <0>;
		pad-type = "rfast";
	};
	/omit-if-no-ref/ can23_tx_p14_9: can23_tx_p14_9 {
		pinmux = <TC3XX_OUTPUT_PINMUX(14, 9, O2)>;
		output-enable;
		pad-type = "fast";
	};
	/omit-if-no-ref/ can23_tx_p22_10: can23_tx_p22_10 {
		pinmux = <TC3XX_OUTPUT_PINMUX(22, 10, O5)>;
		output-enable;
		pad-type = "rfast";
	};
	/omit-if-no-ref/ can23_tx_p23_2: can23_tx_p23_2 {
		pinmux = <TC3XX_OUTPUT_PINMUX(23, 2, O4)>;
		output-enable;
		pad-type = "rfast";
	};
	/omit-if-no-ref/ geth1_grefclk_p22_7: geth1_grefclk_p22_7 {
		pinmux = <TC3XX_INPUT_PINMUX(22, 7, A)>;
		pin-type = <0>;
		pad-type = "slow";
	};
	/omit-if-no-ref/ geth1_mdc_p22_8: geth1_mdc_p22_8 {
		pinmux = <TC3XX_OUTPUT_PINMUX(22, 8, O6)>;
		output-enable;
		output-select;
		pad-type = "slow";
	};
	/omit-if-no-ref/ geth1_mdio_p22_9: geth1_mdio_p22_9 {
		pinmux = <TC3XX_INPUT_PINMUX(22, 9, C)>;
		pin-type = <0>;
		pad-type = "slow";
	};
	/omit-if-no-ref/ geth1_rctl_p22_6: geth1_rctl_p22_6 {
		pinmux = <TC3XX_INPUT_PINMUX(22, 6, A)>;
		pin-type = <4>;
		pad-type = "slow";
	};
	/omit-if-no-ref/ geth1_refclk_p22_5: geth1_refclk_p22_5 {
		pinmux = <TC3XX_INPUT_PINMUX(22, 5, A)>;
		pin-type = <1>;
		pad-type = "slow";
	};
	/omit-if-no-ref/ geth1_rxclk_p22_5: geth1_rxclk_p22_5 {
		pinmux = <TC3XX_INPUT_PINMUX(22, 5, A)>;
		pin-type = <1>;
		pad-type = "slow";
	};
	/omit-if-no-ref/ geth1_rxclk_p22_8: geth1_rxclk_p22_8 {
		pinmux = <TC3XX_INPUT_PINMUX(22, 8, C)>;
		pin-type = <1>;
		pad-type = "slow";
	};
	/omit-if-no-ref/ geth1_rxclk_p22_12: geth1_rxclk_p22_12 {
		pinmux = <TC3XX_INPUT_PINMUX(22, 12, B)>;
		pin-type = <1>;
		pad-type = "rfast";
	};
	/omit-if-no-ref/ geth1_rxd0_p22_4: geth1_rxd0_p22_4 {
		pinmux = <TC3XX_INPUT_PINMUX(22, 4, A)>;
		pin-type = <6>;
		pad-type = "slow";
	};
	/omit-if-no-ref/ geth1_rxd1_p23_7: geth1_rxd1_p23_7 {
		pinmux = <TC3XX_INPUT_PINMUX(23, 7, A)>;
		pin-type = <7>;
		pad-type = "slow";
	};
	/omit-if-no-ref/ geth1_rxd2_p23_6: geth1_rxd2_p23_6 {
		pinmux = <TC3XX_INPUT_PINMUX(23, 6, A)>;
		pin-type = <8>;
		pad-type = "slow";
	};
	/omit-if-no-ref/ geth1_rxd3_p23_5: geth1_rxd3_p23_5 {
		pinmux = <TC3XX_INPUT_PINMUX(23, 5, A)>;
		pin-type = <9>;
		pad-type = "fast";
	};
	/omit-if-no-ref/ geth1_rxdv_p22_0: geth1_rxdv_p22_0 {
		pinmux = <TC3XX_INPUT_PINMUX(22, 0, B)>;
		pin-type = <4>;
		pad-type = "fast";
	};
	/omit-if-no-ref/ geth1_rxdv_p22_6: geth1_rxdv_p22_6 {
		pinmux = <TC3XX_INPUT_PINMUX(22, 6, A)>;
		pin-type = <4>;
		pad-type = "slow";
	};
	/omit-if-no-ref/ geth1_rxer_p22_1: geth1_rxer_p22_1 {
		pinmux = <TC3XX_INPUT_PINMUX(22, 1, A)>;
		pin-type = <5>;
		pad-type = "fast";
	};
	/omit-if-no-ref/ geth1_txclk_p22_5: geth1_txclk_p22_5 {
		pinmux = <TC3XX_INPUT_PINMUX(22, 5, B)>;
		pin-type = <10>;
		pad-type = "slow";
	};
	/omit-if-no-ref/ geth1_txclk_p22_7: geth1_txclk_p22_7 {
		pinmux = <TC3XX_INPUT_PINMUX(22, 7, A)>;
		pin-type = <10>;
		pad-type = "slow";
	};
	/omit-if-no-ref/ geth1_txclk_p22_12: geth1_txclk_p22_12 {
		pinmux = <TC3XX_OUTPUT_PINMUX(22, 12, O7)>;
		output-enable;
		output-select;
		pad-type = "rfast";
	};
	/omit-if-no-ref/ geth1_txd0_p22_10: geth1_txd0_p22_10 {
		pinmux = <TC3XX_OUTPUT_PINMUX(22, 10, O6)>;
		output-enable;
		output-select;
		pad-type = "rfast";
	};
	/omit-if-no-ref/ geth1_txd1_p23_4: geth1_txd1_p23_4 {
		pinmux = <TC3XX_OUTPUT_PINMUX(23, 4, O6)>;
		output-enable;
		pad-type = "rfast";
	};
	/omit-if-no-ref/ geth1_txd2_p23_3: geth1_txd2_p23_3 {
		pinmux = <TC3XX_OUTPUT_PINMUX(23, 3, O6)>;
		output-enable;
		pad-type = "rfast";
	};
	/omit-if-no-ref/ geth1_txd3_p23_2: geth1_txd3_p23_2 {
		pinmux = <TC3XX_OUTPUT_PINMUX(23, 2, O6)>;
		output-enable;
		pad-type = "rfast";
	};
	/omit-if-no-ref/ geth1_txen_p22_11: geth1_txen_p22_11 {
		pinmux = <TC3XX_OUTPUT_PINMUX(22, 11, O6)>;
		output-enable;
		output-select;
		pad-type = "rfast";
	};
	/omit-if-no-ref/ geth1_txer_p22_12: geth1_txer_p22_12 {
		pinmux = <TC3XX_OUTPUT_PINMUX(22, 12, O6)>;
		output-enable;
		output-select;
		pad-type = "rfast";
	};
	/omit-if-no-ref/ geth_grefclk_p11_5: geth_grefclk_p11_5 {
		pinmux = <TC3XX_INPUT_PINMUX(11, 5, A)>;
		pin-type = <0>;
		pad-type = "slow";
	};
	/omit-if-no-ref/ geth_mdc_p2_8: geth_mdc_p2_8 {
		pinmux = <TC3XX_OUTPUT_PINMUX(2, 8, O6)>;
		output-enable;
		pad-type = "slow";
	};
	/omit-if-no-ref/ geth_mdc_p12_0: geth_mdc_p12_0 {
		pinmux = <TC3XX_OUTPUT_PINMUX(12, 0, O6)>;
		output-enable;
		pad-type = "slow";
	};
	/omit-if-no-ref/ geth_mdc_p21_2: geth_mdc_p21_2 {
		pinmux = <TC3XX_OUTPUT_PINMUX(21, 2, O5)>;
		output-enable;
		pad-type = "fast";
	};
	/omit-if-no-ref/ geth_mdio_p0_0: geth_mdio_p0_0 {
		pinmux = <TC3XX_INPUT_PINMUX(0, 0, A)>;
		pin-type = <0>;
		pad-type = "fast";
	};
	/omit-if-no-ref/ geth_mdio_p12_1: geth_mdio_p12_1 {
		pinmux = <TC3XX_INPUT_PINMUX(12, 1, C)>;
		pin-type = <0>;
		pad-type = "slow";
	};
	/omit-if-no-ref/ geth_mdio_p21_3: geth_mdio_p21_3 {
		pinmux = <TC3XX_INPUT_PINMUX(21, 3, D)>;
		pin-type = <0>;
		pad-type = "fast";
	};
	/omit-if-no-ref/ geth_rctl_p11_11: geth_rctl_p11_11 {
		pinmux = <TC3XX_INPUT_PINMUX(11, 11, A)>;
		pin-type = <4>;
		pad-type = "fast";
	};
	/omit-if-no-ref/ geth_refclk_p11_12: geth_refclk_p11_12 {
		pinmux = <TC3XX_INPUT_PINMUX(11, 12, A)>;
		pin-type = <1>;
		pad-type = "fast";
	};
	/omit-if-no-ref/ geth_rxclk_p11_4: geth_rxclk_p11_4 {
		pinmux = <TC3XX_INPUT_PINMUX(11, 4, B)>;
		pin-type = <1>;
		pad-type = "rfast";
	};
	/omit-if-no-ref/ geth_rxclk_p11_12: geth_rxclk_p11_12 {
		pinmux = <TC3XX_INPUT_PINMUX(11, 12, A)>;
		pin-type = <1>;
		pad-type = "fast";
	};
	/omit-if-no-ref/ geth_rxclk_p12_0: geth_rxclk_p12_0 {
		pinmux = <TC3XX_INPUT_PINMUX(12, 0, C)>;
		pin-type = <1>;
		pad-type = "slow";
	};
	/omit-if-no-ref/ geth_rxd0_p11_10: geth_rxd0_p11_10 {
		pinmux = <TC3XX_INPUT_PINMUX(11, 10, A)>;
		pin-type = <6>;
		pad-type = "fast";
	};
	/omit-if-no-ref/ geth_rxd1_p11_9: geth_rxd1_p11_9 {
		pinmux = <TC3XX_INPUT_PINMUX(11, 9, A)>;
		pin-type = <7>;
		pad-type = "fast";
	};
	/omit-if-no-ref/ geth_rxd2_p11_8: geth_rxd2_p11_8 {
		pinmux = <TC3XX_INPUT_PINMUX(11, 8, A)>;
		pin-type = <8>;
		pad-type = "slow";
	};
	/omit-if-no-ref/ geth_rxd3_p11_7: geth_rxd3_p11_7 {
		pinmux = <TC3XX_INPUT_PINMUX(11, 7, A)>;
		pin-type = <9>;
		pad-type = "slow";
	};
	/omit-if-no-ref/ geth_rxdv_p11_11: geth_rxdv_p11_11 {
		pinmux = <TC3XX_INPUT_PINMUX(11, 11, A)>;
		pin-type = <4>;
		pad-type = "fast";
	};
	/omit-if-no-ref/ geth_rxdv_p11_14: geth_rxdv_p11_14 {
		pinmux = <TC3XX_INPUT_PINMUX(11, 14, B)>;
		pin-type = <4>;
		pad-type = "slow";
	};
	/omit-if-no-ref/ geth_rxer_p10_0: geth_rxer_p10_0 {
		pinmux = <TC3XX_INPUT_PINMUX(10, 0, C)>;
		pin-type = <5>;
		pad-type = "slow";
	};
	/omit-if-no-ref/ geth_rxer_p11_13: geth_rxer_p11_13 {
		pinmux = <TC3XX_INPUT_PINMUX(11, 13, A)>;
		pin-type = <5>;
		pad-type = "slow";
	};
	/omit-if-no-ref/ geth_rxer_p21_7: geth_rxer_p21_7 {
		pinmux = <TC3XX_INPUT_PINMUX(21, 7, B)>;
		pin-type = <5>;
		pad-type = "fast";
	};
	/omit-if-no-ref/ geth_txclk_p11_4: geth_txclk_p11_4 {
		pinmux = <TC3XX_OUTPUT_PINMUX(11, 4, O7)>;
		output-enable;
		output-select;
		pad-type = "rfast";
	};
	/omit-if-no-ref/ geth_txclk_p11_5: geth_txclk_p11_5 {
		pinmux = <TC3XX_INPUT_PINMUX(11, 5, A)>;
		pin-type = <10>;
		pad-type = "slow";
	};
	/omit-if-no-ref/ geth_txclk_p11_12: geth_txclk_p11_12 {
		pinmux = <TC3XX_INPUT_PINMUX(11, 12, B)>;
		pin-type = <10>;
		pad-type = "fast";
	};
	/omit-if-no-ref/ geth_txd0_p11_3: geth_txd0_p11_3 {
		pinmux = <TC3XX_OUTPUT_PINMUX(11, 3, O6)>;
		output-enable;
		output-select;
		pad-type = "rfast";
	};
	/omit-if-no-ref/ geth_txd1_p11_2: geth_txd1_p11_2 {
		pinmux = <TC3XX_OUTPUT_PINMUX(11, 2, O6)>;
		output-enable;
		output-select;
		pad-type = "rfast";
	};
	/omit-if-no-ref/ geth_txd2_p11_1: geth_txd2_p11_1 {
		pinmux = <TC3XX_OUTPUT_PINMUX(11, 1, O6)>;
		output-enable;
		output-select;
		pad-type = "rfast";
	};
	/omit-if-no-ref/ geth_txd3_p11_0: geth_txd3_p11_0 {
		pinmux = <TC3XX_OUTPUT_PINMUX(11, 0, O6)>;
		output-enable;
		output-select;
		pad-type = "rfast";
	};
	/omit-if-no-ref/ geth_txen_p11_6: geth_txen_p11_6 {
		pinmux = <TC3XX_OUTPUT_PINMUX(11, 6, O6)>;
		output-enable;
		output-select;
		pad-type = "rfast";
	};
	/omit-if-no-ref/ geth_txer_p11_4: geth_txer_p11_4 {
		pinmux = <TC3XX_OUTPUT_PINMUX(11, 4, O6)>;
		output-enable;
		output-select;
		pad-type = "rfast";
	};
};

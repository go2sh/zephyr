## dts/bindings/ethernet/snps,designware-ethernet-tx-queue.yaml
```yaml
# Copyright (c) 2024, Infineon Technologies AG
# SPDX-License-Identifier: Apache-2.0

description: Synopsys DesignWare Ethernet TX Queues Config

compatible: "snps,designware-ethernet-tx-queues"

properties:
  snps,tx-queues-to-use:
    type: int
    description: number of TX queues to be used in the driver
  snps,tx-sched-wrr:
    type: boolean
    description: Weighted Round Robin
  snps,tx-sched-wfq:
    type: boolean
    description: Weighted Fair Queuing
  snps,tx-sched-dwrr:
    type: boolean
    description: Deficit Weighted Round Robin
  snps,tx-sched-sp:
    type: boolean
    description: Strict priority

child-binding:
  description: TX Queue configuration
  properties:
    snps,size:
      type: int
      description: Dedicated Fifo size
    snps,weight:
      type: int
      description: TX queue weight (if using a DCB weight algorithm)
    snps,threshold:
      type: int
      enum:
        - 32
        - 64
        - 96
        - 128
        - 192
        - 256
        - 384
        - 512
    snps,cut-through:
      type: boolean
    snps,store-and-forward:
      type: boolean
    snps,dcb-algorithm:
      type: boolean
      description: TX queue will be working in DCB
    snps,avb-algorithm:
      type: boolean
      description:
        TX queue will be working in AVB.
        Queue 0 is reserved for legacy traffic and so no AVB is
        available in this queue.
    snps,send_slope:
      type: int
      description: enable Low Power Interface
    snps,idle_slope:
      type: int
      description: unlock on WoL
    snps,high_credit:
      type: int
      description: max write outstanding req. limit
    snps,low_credit:
      type: int
      description: max read outstanding req. limit
    snps,priority:
      type: int
      description:
        Bitmask of the tagged frames priorities assigned to the queue.
        When a PFC frame is received with priorities matching the bitmask,
        the queue is blocked from transmitting for the pause time specified
        in the PFC frame.
    snps,coe-unsupported:
      type: boolean
      description: TX checksum offload is unsupported by the TX queue.
```

## dts/bindings/ethernet/snps,designware-ethernet.yaml
```yaml
# Copyright (c) 2021, BayLibre SAS
# SPDX-License-Identifier: Apache-2.0

description: Synopsys DesignWare Ethernet

compatible: "snps,designware-ethernet"

include: [ethernet-controller.yaml, pinctrl-device.yaml]

properties:
  reg:
    required: true
  interrupts:
    required: true
  snps,rx-channel-to-use:
    type: int
    default: 1
  snps,address-aligned-burst:
    type: boolean
  snps,fixed-burst-length:
    type: boolean
  snps,burst-length:
    type: int
    enum: [ 1, 2, 4, 8, 16, 32, 64, 128, 256]
    default: 1
  ptp-clock:
    type: phandle
```

## dts/bindings/ethernet/snps,dwc-eth-qos-platform.yaml
```yaml
# Copyright (c) 2021, BayLibre SAS
# SPDX-License-Identifier: Apache-2.0

description: Synopsys DesignWare Ethernet

compatible: "snps,dwc-eth-qos-platform"

include: [base.yaml, pinctrl-device.yaml]

properties:
  reg:
    required: true
```

## dts/bindings/ethernet/snps,dwc-eth-qos-ptp-clock.yaml
```yaml
# Copyright 2024 Infineon Technologies AG
# SPDX-License-Identifier: Apache-2.0

description: Synopsys Designware Ethernet QoS PTP (Precision Time Protocol) Clock

compatible: "snps,dwc-eth-qos-ptp-clock"

include: ["base.yaml"]

properties:
  resolution:
    type: int
```

## dts/bindings/interrupt-controller/infineon,tc-ir.yaml
```yaml
# Copyright (c) Infineon Technologies AG
# SPDX-License-Identifier: Apache-2.0

description: Infineon TC3xx Interrupt Router

compatible: "infineon,tc-ir"

include: [interrupt-controller.yaml, base.yaml]

properties:
  reg:
    required: true
    
  "#interrupt-cells":
    const: 2

interrupt-cells:
  - irq
  - priority
```

## dts/bindings/mdio/snps,dwc-eth-qos-mdio.yaml
```yaml
# Copyright (c) 2024 Infineon Technologies AG
# SPDX-License-Identifier: Apache-2.0

description: Synopsys DWC Ethenret QoS MDIO node

compatible: "snps,dwc-eth-qos-mdio"

include:
  - name: mdio-controller.yaml
  - name: pinctrl-device.yaml
```

## dts/bindings/serial/infineon,asclin-uart.yaml
```yaml
# Copyright (c) 2024, Infineon Technologies AG
# SPDX-License-Identifier: Apache-2.0

description: Infineon ASCLIN Uart

compatible: "infineon,asclin-uart"

include: [uart-controller.yaml,  pinctrl-device.yaml]

properties:
  reg:
    required: true

  interrupts:
    required: true
```

## dts/bindings/timer/infineon,tc3xx-stm.yaml
```yaml
# Copyright (c) 2024 Infineon Technologies AG
# SPDX-License-Identifier: Apache-2.0

description: TC3xx System Timer Module (STM)

compatible: "infineon,tc3xx-stm"

include: base.yaml

properties:
  reg:
    required: true

  interrupts:
    required: true

  clocks:
    required: true

  freeze:
    type: boolean
    description: Stops the timer when the chip enters Debug mode.
```

## soc/infineon/infineon_aurix/Kconfig
```kconfig
# Copyright (c) 2024 Infineon Technologies AG
# SPDX-License-Identifier: Apache-2.0

config SOC_FAMILY_INFINEON_AURIX
	bool

if SOC_FAMILY_INFINEON_AURIX

rsource "*/Kconfig"

endif # SOC_FAMILY_INFINEON_AURIX
```

## soc/infineon/infineon_aurix/Kconfig.defconfig
```kconfig
# Copyright (c) 2024 Infineon Technologies AG
# SPDX-License-Identifier: Apache-2.0

if SOC_FAMILY_INFINEON_AURIX

# rsource "*/Kconfig.defconfig"

config PINCTRL
	default y

endif # SOC_FAMILY_INFINEON_AURIX
```

## soc/infineon/infineon_aurix/Kconfig.soc
```kconfig
# Copyright 2024 Infineon Technologies AG
# SPDX-License-Identifier: Apache-2.0


config SOC_FAMILY_INFINEON_AURIX
	bool

config SOC_SERIES_TC3XX
	bool
	help
	  Enable support for TC3XX MCU series

config SOC_FAMILY
	default "infineon_aurix" if SOC_FAMILY_INFINEON_AURIX


rsource "*/Kconfig.soc"
```

## soc/infineon/infineon_aurix/tc3xx/Kconfig
```kconfig
# Copyright (c) 2024 Infineon Technologies AG
# SPDX-License-Identifier: Apache-2.0

config SOC_SERIES_TC3XX
	select TRICORE
	select CPU_TC162
	select TC_IR
	select CLOCK_CONTROL
```

## soc/infineon/infineon_aurix/tc3xx/Kconfig.soc
```kconfig
# Copyright (c) 2024 Infineon Technologies AG
# SPDX-License-Identifier: Apache-2.0

# Infineon Aurix 2nd Generation Devices

config SOC_SERIES_TC3XX
	select SOC_FAMILY_INFINEON_AURIX
	help
	  Enable support for TC3XX MCU series

config SOC_SERIES
    default "tc3xx" if SOC_SERIES_TC3XX
	
config SOC_TC375TP
	bool
	select SOC_SERIES_TC3XX

config SOC_TC377TX
	bool
	select SOC_SERIES_TC3XX

config SOC
	default "tc375tp" if SOC_TC375TP
	default "tc375tx" if SOC_TC377TX
```
